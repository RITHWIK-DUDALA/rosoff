## firmware/esp32_micro_ros/main/Kconfig.projbuild
```kconfig
menu "micro-ROS CDPR Firmware Settings"

    config MICRO_ROS_APP_STACK
        int "Stack size of the micro-ROS task (Bytes)"
        default 16384
        help
            Stack size in Bytes for the micro-ROS FreeRTOS task.

    config MICRO_ROS_APP_TASK_PRIO
        int "Priority of the micro-ROS task"
        default 5
        help
            Priority of the micro-ROS task (higher value means higher priority).

endmenu
```

## firmware/esp32_micro_ros/sdkconfig.defaults
```kconfig
# Micro-ROS ESP32 Default Configuration
CONFIG_ESP32_DEFAULT_CPU_FREQ_240=y
CONFIG_ESP32_DEFAULT_CPU_FREQ_MHZ=240
CONFIG_FREERTOS_HZ=1000
CONFIG_ESP_MAIN_TASK_STACK_SIZE=16384
CONFIG_LWIP_LOCAL_HOSTNAME="cdpr-esp32"
CONFIG_MICROROS_APP_STACK=16384
CONFIG_MICROROS_APP_TASK_PRIO=5
CONFIG_MICRO_ROS_ESP_XRCE_DDS_MIDDLEWARE=y
CONFIG_MICRO_ROS_ESP_UART_TRANSPORT=y
CONFIG_MICROROS_UART_TXD=17
CONFIG_MICROROS_UART_RXD=16
CONFIG_MICROROS_UART_RTS=-1
CONFIG_MICROROS_UART_CTS=-1
```
